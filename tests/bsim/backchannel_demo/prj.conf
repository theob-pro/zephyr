## CMakeLists.txt
```
# SPDX-License-Identifier: Apache-2.0

cmake_minimum_required(VERSION 3.20.0)

find_package(Zephyr REQUIRED HINTS $ENV{ZEPHYR_BASE})

project(backchannel_demo)

# This contains babblesim-specific helpers, e.g. device synchronization.
add_subdirectory(${ZEPHYR_BASE}/tests/bsim/babblekit babblekit)
target_link_libraries(app PRIVATE babblekit)

zephyr_include_directories(
  ${BSIM_COMPONENTS_PATH}/libUtilv1/src/
  ${BSIM_COMPONENTS_PATH}/libPhyComv1/src/
)

target_sources(app PRIVATE
  src/main.c
  src/devices.c
)
```

## prj.conf
```kconfig
CONFIG_ASSERT=y

CONFIG_LOG=y
CONFIG_THREAD_NAME=y
CONFIG_LOG_THREAD_ID_PREFIX=y

CONFIG_ARCH_POSIX_TRAP_ON_FATAL=y
```

## src/main.c
```c
/*
 * Copyright (c) 2024 Nordic Semiconductor ASA
 *
 * SPDX-License-Identifier: Apache-2.0
 */

#include <zephyr/kernel.h>

#include "bs_tracing.h"
#include "bstests.h"
#include "babblekit/testcase.h"

extern void entrypoint_device1(void);
extern void entrypoint_device2(void);
extern void entrypoint_device3(void);
extern enum bst_result_t bst_result;

static void test_end_cb(void)
{
	if (bst_result != Passed) {
		TEST_PRINT("Test has not passed.");
	}
}

static const struct bst_test_instance entrypoints[] = {
	{
		.test_id = "device1",
		.test_delete_f = test_end_cb,
		.test_main_f = entrypoint_device1,
	},
	{
		.test_id = "device2",
		.test_delete_f = test_end_cb,
		.test_main_f = entrypoint_device2,
	},
	{
		.test_id = "device3",
		.test_delete_f = test_end_cb,
		.test_main_f = entrypoint_device3,
	},
	BSTEST_END_MARKER,
};

static struct bst_test_list *install(struct bst_test_list *tests)
{
	return bst_add_tests(tests, entrypoints);
};

bst_test_install_t test_installers[] = {install, NULL};

int main(void)
{
	bst_main();

	return 0;
}
```

## src/devices.c
```c
/*
 * Copyright (c) 2024 Nordic Semiconductor ASA
 *
 * SPDX-License-Identifier: Apache-2.0
 */

#include <zephyr/kernel.h>

#include <zephyr/logging/log.h>

#include "bs_tracing.h"
#include "bstests.h"
#include "bs_tracing.h"
#include "time_machine.h"
#include "bs_pc_backchannel.h"
#include "bs_types.h"
#include "argparse.h"

#include "babblekit/testcase.h"

LOG_MODULE_REGISTER(backchannel_demo, LOG_LEVEL_DBG);

#define CHANNEL_ID_1 0 /* d0 <> d1 */
#define CHANNEL_ID_2 1 /* d0 <> d3 */
#define CHANNEL_ID_3 2 /* d1 <> d3 */

#define MSG_SIZE 1

int backchannel_init(void)
{
	uint device_number = bsim_args_get_global_device_nbr();
	uint device_numbers[2] = {0};
	uint channel_numbers[2] = {0};
	uint *ch;

	LOG_DBG("%s: device %d", __func__, device_number);

	if (device_number == 0) {
		device_numbers[0] = 1;
		device_numbers[1] = 2;

		channel_numbers[0] = CHANNEL_ID_1;
		channel_numbers[1] = CHANNEL_ID_2;
	} else if (device_number == 1) {
		device_numbers[0] = 0;
		device_numbers[1] = 2;

		channel_numbers[0] = CHANNEL_ID_1;
		channel_numbers[1] = CHANNEL_ID_3;
	} else if (device_number == 2) {
		device_numbers[0] = 0;
		device_numbers[1] = 1;

		channel_numbers[0] = CHANNEL_ID_2;
		channel_numbers[1] = CHANNEL_ID_3;
	} else {
		LOG_ERR("Device %d is unknown.", device_numbers);
		return -1;
	}

	ch = bs_open_back_channel(device_number, device_numbers, channel_numbers,
				  ARRAY_SIZE(channel_numbers));

	if (ch == NULL) {
		LOG_ERR("Backchannel initialization failed.");
		return -1;
	}

	LOG_DBG("Backchannel initialized.");

	return 0;
}

/**
 * @brief Wait for a sync message on channel_id
 *
 * @param channel_id this is the index of the channel ID `channel_numbers` in the `backchannel_init` function
 */
void backchannel_sync_wait(uint channel_id)
{
	uint8_t sync_msg[MSG_SIZE];
	uint device_number = bsim_args_get_global_device_nbr();

	LOG_DBG("Device %d is waiting for sync");

	while (true) {
		if (bs_bc_is_msg_received(channel_id) > 0) {
			bs_bc_receive_msg(channel_id, sync_msg, ARRAY_SIZE(sync_msg));
			if (sync_msg[0] != device_number) {
				/* Received a message from another device, exit */
				break;
			}
		}

		k_sleep(K_MSEC(1));
	}

	LOG_DBG("Sync received");
}

/**
 * @brief Send a sync message to a device listening on channel_id
 *
 * @param channel_id this is the index of the channel ID `channel_numbers` in the `backchannel_init` function
 */
void backchannel_sync_send(uint channel_id)
{
	uint device_number = bsim_args_get_global_device_nbr();
	uint8_t sync_msg[MSG_SIZE] = {device_number};

	LOG_DBG("Sync send");

	bs_bc_send_msg(channel_id, sync_msg, ARRAY_SIZE(sync_msg));
}

void entrypoint_device1(void)
{
	int err;

	err = backchannel_init();
	TEST_ASSERT(err == 0, "Failed to init backchannel");

	LOG_DBG("Waiting for device 1...");
	backchannel_sync_wait(0);

	LOG_DBG("Sending sync to device 3");
	backchannel_sync_send(1);

	TEST_PASS("Device 1 passed.");
}

void entrypoint_device2(void)
{
	int err;

	err = backchannel_init();
	TEST_ASSERT(err == 0, "Failed to init backchannel");

	LOG_DBG("Waiting for device 2...");
	backchannel_sync_wait(1);

	LOG_DBG("Sending sync to device 1");
	backchannel_sync_send(0);

	TEST_PASS("Device 2 passed.");
}

void entrypoint_device3(void)
{
	int err;

	err = backchannel_init();
	TEST_ASSERT(err == 0, "Failed to init backchannel");

	k_sleep(K_MSEC(1));

	LOG_DBG("Sending sync to device 1");
	backchannel_sync_send(1);

	LOG_DBG("Waiting for device 0");
	backchannel_sync_wait(0);

	TEST_PASS("Device 3 passed.");
}
```
