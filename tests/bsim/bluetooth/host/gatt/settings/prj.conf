## CMakeLists.txt
```
# SPDX-License-Identifier: Apache-2.0

cmake_minimum_required(VERSION 3.20.0)

find_package(Zephyr REQUIRED HINTS $ENV{ZEPHYR_BASE})
project(bsim_test_gatt_settings)

target_sources(app PRIVATE
  src/server.c
  src/client.c
  src/utils.c
  src/gatt_utils.c
  src/main.c
  )

zephyr_include_directories(
  ${BSIM_COMPONENTS_PATH}/libUtilv1/src/
  ${BSIM_COMPONENTS_PATH}/libPhyComv1/src/
  )
```

## prj.conf
```kconfig
CONFIG_BT=y
CONFIG_BT_PERIPHERAL=y
CONFIG_BT_CENTRAL=y
CONFIG_BT_DEVICE_NAME="GATT settings"

CONFIG_LOG=y
CONFIG_ASSERT=y
CONFIG_BT_TESTING=y

CONFIG_BT_AUTO_PHY_UPDATE=n
CONFIG_BT_AUTO_DATA_LEN_UPDATE=n
CONFIG_BT_GAP_AUTO_UPDATE_CONN_PARAMS=n

CONFIG_BT_SMP=y
CONFIG_BT_GATT_CLIENT=y
CONFIG_BT_GATT_DYNAMIC_DB=y
CONFIG_BT_GATT_CACHING=y

CONFIG_SETTINGS=y
CONFIG_BT_SETTINGS=y
CONFIG_FLASH=y
CONFIG_FLASH_PAGE_LAYOUT=y
CONFIG_NVS=y
CONFIG_FLASH_MAP=y
CONFIG_SETTINGS_NVS=y

CONFIG_BT_GATT_AUTO_DISCOVER_CCC=y
CONFIG_BT_GATT_AUTO_RESUBSCRIBE=n

CONFIG_BT_PRIVACY=n
```

## prj_2.conf
```kconfig
CONFIG_BT=y
CONFIG_BT_PERIPHERAL=y
CONFIG_BT_CENTRAL=y
CONFIG_BT_DEVICE_NAME="GATT settings"

CONFIG_LOG=y
CONFIG_ASSERT=y
CONFIG_BT_TESTING=y

CONFIG_BT_AUTO_PHY_UPDATE=n
CONFIG_BT_AUTO_DATA_LEN_UPDATE=n
CONFIG_BT_GAP_AUTO_UPDATE_CONN_PARAMS=n

CONFIG_BT_SMP=y
CONFIG_BT_GATT_CLIENT=y
CONFIG_BT_GATT_DYNAMIC_DB=y
CONFIG_BT_GATT_CACHING=y

CONFIG_SETTINGS=y
CONFIG_BT_SETTINGS=y
CONFIG_FLASH=y
CONFIG_FLASH_PAGE_LAYOUT=y
CONFIG_NVS=y
CONFIG_FLASH_MAP=y
CONFIG_SETTINGS_NVS=y

CONFIG_BT_GATT_AUTO_DISCOVER_CCC=y
CONFIG_BT_GATT_AUTO_RESUBSCRIBE=n

CONFIG_BT_PRIVACY=y
```

## src/main.c
```c
/*
 * Copyright (c) 2023 Nordic Semiconductor ASA
 *
 * SPDX-License-Identifier: Apache-2.0
 */

#include "utils.h"
#include "main.h"
#include "argparse.h"
#include "bs_pc_backchannel.h"
#include "bstests.h"

#include <zephyr/sys/__assert.h>

void server_procedure(void);
void client_procedure(void);

#define BS_SECONDS(dur_sec)    ((bs_time_t)dur_sec * USEC_PER_SEC)
#define TEST_TIMEOUT_SIMULATED BS_SECONDS(30)

static int test_round;
static int final_round;

int get_test_round(void)
{
	return test_round;
}

bool is_final_round(void)
{
	return test_round == final_round;
}

static void test_args(int argc, char **argv)
{
	__ASSERT(argc == 2, "Please specify only 2 test arguments\n");

	test_round = atol(argv[0]);
	final_round = atol(argv[1]);

	bs_trace_raw(0, "Test round %u\n", test_round);
	bs_trace_raw(0, "Final round %u\n", final_round);
}

void test_tick(bs_time_t HW_device_time)
{
	bs_trace_debug_time(0, "Simulation ends now.\n");
	if (bst_result != Passed) {
		bst_result = Failed;
		bs_trace_error("Test did not pass before simulation ended.\n");
	}
}

void test_init(void)
{
	bst_ticker_set_next_tick_absolute(TEST_TIMEOUT_SIMULATED);
	bst_result = In_progress;
}

static const struct bst_test_instance test_to_add[] = {
	{
		.test_id = "server",
		.test_pre_init_f = test_init,
		.test_tick_f = test_tick,
		.test_main_f = server_procedure,
		.test_args_f = test_args,
	},
	{
		.test_id = "client",
		.test_pre_init_f = test_init,
		.test_tick_f = test_tick,
		.test_main_f = client_procedure,
		.test_args_f = test_args,
	},
	BSTEST_END_MARKER,
};

static struct bst_test_list *install(struct bst_test_list *tests)
{
	return bst_add_tests(tests, test_to_add);
};

bst_test_install_t test_installers[] = { install, NULL };

int main(void)
{
	bst_main();
	return 0;
}


void backchannel_init(void)
{
	uint device_number = get_device_nbr();
	uint channel_numbers[2] = { 0, 0, };
	uint device_numbers[2];
	uint num_ch;
	uint *ch;

	/* No backchannels to next/prev device if only device */
	if (get_test_round() == 0 && is_final_round()) {
		return;
	}

	/* Each `server` round/instance gets a connection to the previous and to
	 * the next instance in the chain. It waits until it is signalled by the
	 * previous instance, then runs its test procedure and finally signals
	 * the next instance in the chain.
	 *
	 * The two ends of the chain get only one channel, hence the difference
	 * in handling.
	 */

	if (get_test_round() == 0) {
		/* send only */
		device_numbers[0] = get_device_nbr() + 1;
		num_ch = 1;

	} else if (is_final_round()) {
		/* receive only */
		device_numbers[0] = get_device_nbr() - 1;
		num_ch = 1;

	} else {
		/* send signal */
		device_numbers[1] = get_device_nbr() + 1;
		/* receive signal */
		device_numbers[0] = get_device_nbr() - 1;
		num_ch = 2;
	}

	printk("Opening backchannels\n");
	ch = bs_open_back_channel(device_number, device_numbers,
				  channel_numbers, num_ch);
	if (!ch) {
		FAIL("Unable to open backchannel\n");
	}
}

#define MSG_SIZE 1

void backchannel_sync_send(uint channel)
{
	uint8_t sync_msg[MSG_SIZE] = { get_device_nbr() };

	printk("Sending sync\n");
	bs_bc_send_msg(channel, sync_msg, ARRAY_SIZE(sync_msg));
}

void backchannel_sync_wait(uint channel)
{
	uint8_t sync_msg[MSG_SIZE];

	while (true) {
		if (bs_bc_is_msg_received(channel) > 0) {
			bs_bc_receive_msg(channel, sync_msg,
					  ARRAY_SIZE(sync_msg));
			if (sync_msg[0] != get_device_nbr()) {
				/* Received a message from another device, exit */
				break;
			}
		}

		k_sleep(K_MSEC(1));
	}

	printk("Sync received\n");
}

/* We can't really kill the device/process without borking the bsim
 * backchannels, so the next best thing is stopping all threads from processing,
 * thus stopping the Bluetooth host from processing the disconnect event (or any
 * event, really) coming from the link-layer.
 */
static void stop_all_threads(void)
{
	irq_lock();
	/* promote to highest priority */
	// k_thread_priority_set(k_current_get(), K_HIGHEST_THREAD_PRIO);
	/* busy-wait loop */
	for (;;) {
		// k_busy_wait(1000);
		// k_yield();
		k_sleep(K_SECONDS(1));
	}
}

void signal_next_test_round(void)
{
	uint channel = get_test_round() == 0 ? 0 : 1;

	if (!is_final_round()) {
		backchannel_sync_send(channel);
	}

	PASS("round %d over\n", get_test_round());
	stop_all_threads();
}

void wait_for_round_start(void)
{
	backchannel_init();

	if (get_test_round() == 0) return;

	backchannel_sync_wait(0);
}
```

## src/client.c
```c
/*
 * Copyright (c) 2023 Nordic Semiconductor ASA
 *
 * SPDX-License-Identifier: Apache-2.0
 */

#include "utils.h"
#include "gatt_utils.h"

#include <zephyr/bluetooth/addr.h>
#include <zephyr/bluetooth/bluetooth.h>
#include <zephyr/bluetooth/conn.h>
#include <zephyr/settings/settings.h>
#include <zephyr/toolchain/gcc.h>

#include <stdint.h>
#include <string.h>

void client_round_0(void)
{
	struct bt_conn *conn;

	printk("start round 0...........\n");

	conn = connect_as_peripheral();
	printk("connected: conn %p\n", conn);

	gatt_discover();
	activate_robust_caching();
	/* subscribe to the SC indication, so we don't have to ATT read to
	 * become change-aware.
	 */
	gatt_subscribe_to_service_changed(true);
	read_test_char(true);

	/* We should normally wait until we are bonded to write the CCC / CF
	 * characteristics, but here we bond after the fact on purpose, to
	 * simulate a client that has this exact behavior.
	 * The CCC and CF should still persist on reboot.
	 */
	wait_bonded();

	disconnect(conn);
}

void client_round_1(void)
{
	struct bt_conn *conn;

	printk("start round 1...........\n");

	conn = connect_as_peripheral();
	printk("connected: conn %p\n", conn);
	wait_secured();

	/* server should remember we are change-aware */
	read_test_char(true);

	disconnect(conn);
}

void client_round_2(void)
{
	struct bt_conn *conn;

	printk("start round 2...........\n");

	conn = connect_as_peripheral();
	printk("connected: conn %p\n", conn);
	wait_secured();

	/* We are change-unaware. wait until the Service Changed indication is
	 * received, that should then make us change-aware.
	 */
	wait_for_sc_indication();
	read_test_char(true);

	/* We sleep just enough so that the server's `delayed store` work item
	 * is executed. We still trigger a disconnect, even though the server
	 * device will be unresponsive for this round.
	 */
	k_sleep(K_MSEC(CONFIG_BT_SETTINGS_DELAYED_STORE_MS));
	k_sleep(K_MSEC(10));

	disconnect(conn);
}

void client_round_3(void)
{
	struct bt_conn *conn;

	printk("start round 3...........\n");

	conn = connect_as_peripheral();
	printk("connected: conn %p\n", conn);
	wait_secured();

	/* server should remember we are change-aware */
	read_test_char(true);

	/* Unsubscribe from the SC indication.
	 *
	 * In the next round, we will be change-unaware, so the first ATT read
	 * will fail, but the second one will succeed and we will be marked as
	 * change-aware again.
	 */
	gatt_subscribe_to_service_changed(false);

	disconnect(conn);
}

void client_round_4(void)
{
	struct bt_conn *conn;

	printk("start round 4...........\n");

	conn = connect_as_peripheral();
	printk("connected: conn %p\n", conn);
	wait_secured();

	/* GATT DB has changed again.
	 * Before disc: svc1
	 * After disc: svc1 + svc2
	 * At boot: svc1
	 * Expect a failure on the first read of the same GATT handle.
	 */
	read_test_char(false);
	read_test_char(true);

	disconnect(conn);
}

void client_round_5(void)
{
	printk("start round 5...........\n");
	printk("don't need to do anything, central will "
	       "not connect to us\n");
}

void client_round_6(void)
{
	struct bt_conn *conn;

	printk("start round 6...........\n");
	conn = connect_as_peripheral();
	printk("connected: conn %p\n", conn);
	wait_secured();

	/* GATT DB has changed again.
	 * Expect a failure on the first read of the same GATT handle.
	 */
	read_test_char(false);
	read_test_char(true);

	disconnect(conn);
}

void client_procedure(void)
{
	bt_enable(NULL);
	settings_load();

	client_round_0();
	client_round_1();
	client_round_2();
	client_round_3();
	client_round_4();
	client_round_5();
	client_round_6();

	PASS("PASS\n");
}
```

## src/main.h
```c
/*
 * Copyright (c) 2023 Nordic Semiconductor ASA
 *
 * SPDX-License-Identifier: Apache-2.0
 */

#include <stdbool.h>

int get_test_round(void);
bool is_final_round(void);

void signal_next_test_round(void);
void wait_for_round_start(void);
```

## src/server.c
```c
/*
 * Copyright (c) 2023 Nordic Semiconductor ASA
 *
 * SPDX-License-Identifier: Apache-2.0
 */

#include "utils.h"
#include "main.h"
#include "gatt_utils.h"

#include <zephyr/bluetooth/addr.h>
#include <zephyr/bluetooth/bluetooth.h>
#include <zephyr/bluetooth/conn.h>
#include <zephyr/settings/settings.h>
#include <zephyr/toolchain/gcc.h>

#include <stdint.h>
#include <string.h>

void set_public_addr(void)
{
	bt_addr_le_t addr = {BT_ADDR_LE_RANDOM,
			     {{0x0A, 0x89, 0x67, 0x45, 0x23, 0xC1}}};
	bt_id_create(&addr, NULL);
}

void server_round_0(void)
{
	struct bt_conn *conn;

	conn = connect_as_central();
	wait_for_client_read();

	printk("bonding\n");
	bond(conn);
}

void server_round_1(void)
{
	struct bt_conn *conn;

	/* Wait for GATT DB hash to complete. */
	k_sleep(K_SECONDS(2));
	conn = connect_as_central();
	printk("encrypting\n");
	set_security(conn, BT_SECURITY_L2);

	wait_for_client_read();
	wait_disconnected();

	printk("register second service, peer will be change-unaware\n");
	gatt_register_service_2();
	/* on-disk hash will be different when round 2 (and round 4)
	 * start, the peer will be marked as change-unaware
	 */
	k_sleep(K_MSEC(100));
}

void server_round_2(void)
{
	struct bt_conn *conn;

	conn = connect_as_central();
	printk("encrypting\n");
	set_security(conn, BT_SECURITY_L2);

	wait_for_client_read();

	/* Kill the power before the graceful disconnect, to make sure
	 * that the change-aware status has been written correctly to
	 * NVS. We still have to wait for the delayed work to be run.
	 */
	k_sleep(K_MSEC(CONFIG_BT_SETTINGS_DELAYED_STORE_MS));
	k_sleep(K_MSEC(10));
}

void server_round_3(void)
{
	struct bt_conn *conn;

	conn = connect_as_central();
	printk("encrypting\n");
	set_security(conn, BT_SECURITY_L2);

	wait_for_client_read();
	wait_disconnected();

	printk("register second service, peer will be change-unaware\n");
	gatt_register_service_2();
	/* on-disk hash will be different when round 2 (and round 4)
	 * start, the peer will be marked as change-unaware
	 */
	k_sleep(K_MSEC(100));
}

void server_round_4(void)
{
	struct bt_conn *conn;

	conn = connect_as_central();
	printk("encrypting\n");
	set_security(conn, BT_SECURITY_L2);

	wait_for_client_read();
	wait_disconnected();
}

void server_round_5(void)
{
	gatt_register_service_2();

	/* sleep long enough to ensure the DB hash is stored to disk, but short
	 * enough to make sure the delayed storage work item is not executed.
	 */
	k_sleep(K_MSEC(100));
}

void server_round_6(void)
{
	struct bt_conn *conn;

	gatt_register_service_2();

	conn = connect_as_central();
	printk("encrypting\n");
	set_security(conn, BT_SECURITY_L2);

	wait_for_client_read();
	wait_disconnected();
}

/* What is being tested: since this deals with settings it's not the rounds
 * themselves, but rather the transitions that test expected behavior.
 *
 * Round 0 -> 1: test CCC / CF values written before bonding are stored to NVS
 * if the server reboots before disconnecting.
 *
 * Round 1 -> 2: test change-awareness is updated if GATT DB changes _after_ the
 * peer has disconnected. In round 2 we also make sure we receive the Service
 * Changed indication.
 *
 * Round 2 -> 3: tests `CONFIG_BT_SETTINGS_CF_STORE_ON_WRITE` does its job, and
 * writes the change-awareness before we get disconnected. Basically, this
 * transition simulates a user yanking the power of the device before it has the
 * chance to disconnect.
 *
 * Round 3 -> 4: same as (1->2), except this time we won't get the SC indication
 * (as we have unsubscribed from it). We should instead get the
 * `BT_ATT_ERR_DB_OUT_OF_SYNC` error on the first attribute read. This also
 * tests that robust GATT caching is enforced.
 *
 * Round 4 -> 5: tests change-awareness status is still written on disconnect.
 * This is a non-regression test to make sure we didn't break the previous
 * behavior.
 *
 * Round 5 -> 6: tests DFU corner case: in this case, we are on the first boot
 * of an updated firmware, that will register new services. But for some unknown
 * reason, we decide to reboot before the delayed store work item has had the
 * time to execute and store that the peers are now change-unaware. Round 6 then
 * makes sure that we are indeed change-unaware.
 */
void server_procedure(void)
{
	uint8_t round = get_test_round();

	wait_for_round_start();

	printk("Start test round: %d\n", get_test_round());

	/* Use the same public address for all instances of the central. If we
	 * don't do that, encryption (using the bond stored in NVS) will
	 * fail.
	 */
	set_public_addr();

	gatt_register_service_1();

	bt_enable(NULL);
	settings_load();

	switch (round) {
	case 0:
		server_round_0();
		break;
	case 1:
		server_round_1();
		break;
	case 2:
		server_round_2();
		break;
	case 3:
		server_round_3();
		break;
	case 4:
		server_round_4();
		break;
	case 5:
		server_round_5();
		break;
	case 6:
		server_round_6();
		break;
	default:
		FAIL("Round %d doesn't exist\n", round);
		break;
	}

	signal_next_test_round();
}
```
