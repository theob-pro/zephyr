## CMakeLists.txt
```
# SPDX-License-Identifier: Apache-2.0

cmake_minimum_required(VERSION 3.20.0)

find_package(Zephyr REQUIRED HINTS $ENV{ZEPHYR_BASE})
project(bsim_test_deadlock_tester)

target_sources(app PRIVATE
  src/main.c
)

zephyr_include_directories(
  ../common/
  ${ZEPHYR_BASE}/subsys/bluetooth/common/
  ${BSIM_COMPONENTS_PATH}/libUtilv1/src/
  ${BSIM_COMPONENTS_PATH}/libPhyComv1/src/
)
```

## prj.conf
```kconfig
CONFIG_LOG=y
CONFIG_ASSERT=y
CONFIG_NET_BUF_POOL_USAGE=y
CONFIG_LOG=y

CONFIG_BT=y
CONFIG_BT_CENTRAL=y
CONFIG_BT_PERIPHERAL=y
CONFIG_BT_DEVICE_NAME="Deadlock test"

CONFIG_BT_SMP=y
CONFIG_BT_EATT=y
CONFIG_BT_L2CAP_ECRED=y
CONFIG_BT_L2CAP_DYNAMIC_CHANNEL=y


# Disable auto-initiated procedures so they don't
# mess with the test's execution.
CONFIG_BT_AUTO_PHY_UPDATE=n
CONFIG_BT_AUTO_DATA_LEN_UPDATE=n
CONFIG_BT_GAP_AUTO_UPDATE_CONN_PARAMS=n

# CONFIG_BT_CTLR_RX_BUFFERS=10

CONFIG_BT_MAX_CONN=1

#CONFIG_BT_LL_SW_SPLIT=y


# CONFIG_BT_GATT_CLIENT=y

# Set highest allowed value
CONFIG_BT_EATT_MAX=16
CONFIG_BT_EATT_AUTO_CONNECT=n
CONFIG_THREAD_NAME=y

CONFIG_BT_CONN_TX_MAX=20

CONFIG_BT_LL_SOFTDEVICE_BUILD_TYPE_LIB=y
CONFIG_MPSL_BUILD_TYPE_LIB=y

CONFIG_BT_MAX_CONN=1
CONFIG_BT_BUF_EVT_RX_COUNT=2
CONFIG_BT_BUF_ACL_RX_COUNT=2

CONFIG_BT_CTLR_SDC_TX_PACKET_COUNT=3
CONFIG_BT_CTLR_SDC_RX_PACKET_COUNT=2

CONFIG_BT_HCI_ACL_FLOW_CONTROL=y
CONFIG_BT_HCI_CORE_LOG_LEVEL_DBG=y
CONFIG_BT_HCI_DRIVER_LOG_LEVEL_DBG=y
```

## src/main.c
```c
/*
 * Copyright (c) 2023 Nordic Semiconductor ASA
 *
 * SPDX-License-Identifier: Apache-2.0
 */

#include <zephyr/kernel.h>
#include <zephyr/bluetooth/bluetooth.h>
#include <zephyr/bluetooth/gatt.h>
#include <zephyr/bluetooth/uuid.h>
#include <zephyr/bluetooth/conn.h>

#include "utils.h"
#include "bstests.h"

#include <zephyr/logging/log.h>
LOG_MODULE_REGISTER(tester, LOG_LEVEL_DBG);

DEFINE_FLAG(is_connected);

static ssize_t test_on_attr_read_cb(struct bt_conn *conn, const struct bt_gatt_attr *attr,
				    void *buf, uint16_t len, uint16_t offset)
{
	/* Do not respond until allowed */
	static int i = 0;
	if (!i) {
		LOG_DBG("Sleeping");
		k_sleep(K_SECONDS(20));
	}

	LOG_ERR("handled read %i", i++);

	return bt_gatt_attr_read(conn, attr, buf, len, offset, "data", 4);
}

BT_GATT_SERVICE_DEFINE(test_gatt_service, BT_GATT_PRIMARY_SERVICE(test_service_uuid),
		       BT_GATT_CHARACTERISTIC(test_characteristic_uuid, BT_GATT_CHRC_READ,
					      BT_GATT_PERM_READ, test_on_attr_read_cb, NULL, NULL));

static struct bt_conn *default_conn;

static void connected(struct bt_conn *conn, uint8_t conn_err)
{
	char addr[BT_ADDR_LE_STR_LEN];

	bt_addr_le_to_str(bt_conn_get_dst(conn), addr, sizeof(addr));

	if (conn_err) {
		FAIL("Failed to connect to %s (%u)\n", addr, conn_err);
		return;
	}

	LOG_DBG("%s", addr);

	default_conn = bt_conn_ref(conn);

	SET_FLAG(is_connected);
}

static void disconnected(struct bt_conn *conn, uint8_t reason)
{
	char addr[BT_ADDR_LE_STR_LEN];

	bt_addr_le_to_str(bt_conn_get_dst(conn), addr, sizeof(addr));

	LOG_DBG("%p %s (reason 0x%02x)", conn, addr, reason);

	UNSET_FLAG(is_connected);
}

BT_CONN_CB_DEFINE(conn_callbacks) = {
	.connected = connected,
	.disconnected = disconnected,
};

static void adv(void)
{
	UNSET_FLAG(is_connected);

	int err = bt_le_adv_start(BT_LE_ADV_CONN_NAME, NULL, 0, NULL, 0);

	ASSERT(!err, "Advertising failed to start (err %d)\n", err);

	LOG_DBG("Waiting for Central...");
}

void test_procedure_tester(void)
{
	LOG_DBG("Deadlock tester/peripheral started*");
	int err;

	err = bt_enable(NULL);
	ASSERT(err == 0, "(err %d)\n", err);
	LOG_DBG("Tester Bluetooth initialized.");

	adv();
	WAIT_FOR_FLAG(is_connected);

	k_sleep(K_SECONDS(5));

	WAIT_FOR_FLAG_UNSET(is_connected);

	PASS("Tester done\n");
}

void test_tick(bs_time_t HW_device_time)
{
	bs_trace_debug_time(0, "Simulation ends now.\n");
	if (bst_result != Passed) {
		bst_result = Failed;
		bs_trace_error("Test did not pass before simulation ended.\n");
	}
}

void test_init(void)
{
	bst_ticker_set_next_tick_absolute(TEST_TIMEOUT_SIMULATED);
	bst_result = In_progress;
}

static const struct bst_test_instance test_to_add[] = {
	{
		.test_id = "tester",
		.test_pre_init_f = test_init,
		.test_tick_f = test_tick,
		.test_main_f = test_procedure_tester,
	},
	BSTEST_END_MARKER,
};

static struct bst_test_list *install(struct bst_test_list *tests)
{
	return bst_add_tests(tests, test_to_add);
};

bst_test_install_t test_installers[] = {install, NULL};

int main(void)
{
	bst_main();

	return 0;
}
```
