## CMakeLists.txt
```
# SPDX-License-Identifier: Apache-2.0

cmake_minimum_required(VERSION 3.20.0)

if (NOT DEFINED ENV{BSIM_COMPONENTS_PATH})
  message(FATAL_ERROR "This test requires the BabbleSim simulator. Please set  \
          the  environment variable BSIM_COMPONENTS_PATH to point to its       \
          components folder. More information can be found in                  \
          https://babblesim.github.io/folder_structure_and_env.html")
endif()

find_package(Zephyr HINTS $ENV{ZEPHYR_BASE})
project(bsim_test_smp_pairing_failed_event)

target_sources(app PRIVATE
  src/main.c
  src/central.c
  src/peripheral.c
)

zephyr_include_directories(
  $ENV{BSIM_COMPONENTS_PATH}/libUtilv1/src/
  $ENV{BSIM_COMPONENTS_PATH}/libPhyComv1/src/
  $ENV{ZEPHYR_BASE}/subsys/bluetooth/host/
)
```

## prj.conf
```kconfig
CONFIG_BT=y
CONFIG_BT_CENTRAL=y
CONFIG_BT_PERIPHERAL=y

CONFIG_BT_SMP=y

CONFIG_LOG=y
CONFIG_BT_SMP_LOG_LEVEL_DBG=y
CONFIG_BT_L2CAP_LOG_LEVEL_DBG=y
```

## src/main.c
```c
#include <stddef.h>
#include <stdint.h>
#include <string.h>

#include <zephyr/kernel.h>

#include <zephyr/sys/printk.h>

#include "bs_types.h"
#include "bs_tracing.h"
#include "time_machine.h"
#include "bstests.h"

#include <zephyr/logging/log.h>
LOG_MODULE_REGISTER(bt_bsim_smp_pairing_failed_event, LOG_LEVEL_DBG);

#define FAIL(...)					\
	do {						\
		bst_result = Failed;			\
		bs_trace_error_time_line(__VA_ARGS__);	\
	} while (0)

#define PASS(...)					\
	do {						\
		bst_result = Passed;			\
		bs_trace_info_time(1, __VA_ARGS__);	\
	} while (0)

extern enum bst_result_t bst_result;

#define WAIT_TIME (20e6) /* 20 seconds */

extern void test_central_main();
extern void test_peripheral_main();



static void test_central() {
	test_central_main();
}

static void test_peripheral() {
	test_peripheral_main();
}

void test_tick(bs_time_t HW_device_time)
{
	if (bst_result != Passed) {
		FAIL("Test failed (not passed after %i seconds)\n", WAIT_TIME);
	}
}

static void test_smp_pairing_failed_event_init(void)
{
	bst_ticker_set_next_tick_absolute(WAIT_TIME);
	bst_result = In_progress;
}

static const struct bst_test_instance test_def[] = {
	{
		.test_id = "central",
		.test_descr = "Central waiting for PDU",
		.test_post_init_f = test_smp_pairing_failed_event_init,
		.test_tick_f = test_tick,
		.test_main_f = test_central
	},
	{
		.test_id = "peripheral",
		.test_descr = "Peripheral sending SMP pairing PDU",
		.test_post_init_f = test_smp_pairing_failed_event_init,
		.test_tick_f = test_tick,
		.test_main_f = test_peripheral
	},
	BSTEST_END_MARKER
};

struct bst_test_list *test_smp_pairing_failed_event_install(struct bst_test_list *tests)
{
	return bst_add_tests(tests, test_def);
}

bst_test_install_t test_installers[] = {
	test_smp_pairing_failed_event_install,
	NULL
};

void main(void)
{
        bst_main();
}
```

## src/central.c
```c
#include <stddef.h>
#include <stdint.h>
#include <string.h>

#include <zephyr/kernel.h>

#include <zephyr/sys/printk.h>

#include <zephyr/bluetooth/conn.h>
#include <zephyr/bluetooth/bluetooth.h>

#include "smp.h"
#include "conn_internal.h"
#include "l2cap_internal.h"

static void start_scan(void);
static struct bt_conn *default_conn;

static void smp_send_bad()
{
	struct bt_smp_hdr *hdr;
	struct bt_smp_pairing_confirm *rsp;
	struct net_buf *buf;
	struct bt_smp *smp;

	buf = bt_l2cap_create_pdu_timeout(NULL, 0, K_NO_WAIT);
	__ASSERT_NO_MSG(buf);

	hdr = net_buf_add(buf, sizeof(*hdr));
	hdr->code = BT_SMP_CMD_PAIRING_CONFIRM;

	printk("Inside smp_send_bad\n");

	if (bt_l2cap_send(default_conn, 0x0006, buf)) {
		
		net_buf_unref(buf);
	}

	printk("PDU sent\n");
}

static void device_found(const bt_addr_le_t *addr, int8_t rssi, uint8_t type,
			 struct net_buf_simple *ad)
{
	char addr_str[BT_ADDR_LE_STR_LEN];
	int err;

	if (default_conn) {
		return;
	}

	bt_addr_le_to_str(addr, addr_str, sizeof(addr_str));
	printk("Device found: %s (RSSI %d)\n", addr_str, rssi);

	if (bt_le_scan_stop()) {
        	// PASS("Peripheral test passed\n");
		return;
	}

	err = bt_conn_le_create(addr, BT_CONN_LE_CREATE_CONN, BT_LE_CONN_PARAM_DEFAULT, &default_conn);
	if (err) {
		printk("Create conn to %s failed (%u)\n", addr_str, err);
		start_scan();
	}
}

static void start_scan(void)
{
	int err;

	err = bt_le_scan_start(BT_LE_SCAN_PASSIVE, device_found);
	if (err) {
		printk("Scanning failed to start (err %d)\n", err);
		return;
	}

	printk("Scanning successfully started\n");
}

static void connected(struct bt_conn *conn, uint8_t err)
{
	printk("Central Connected function\n");

	char addr[BT_ADDR_LE_STR_LEN];

	bt_addr_le_to_str(bt_conn_get_dst(conn), addr, sizeof(addr));

	printk("Connected: %s\n", addr);

	smp_send_bad();
}

static void disconnected(struct bt_conn *conn, uint8_t reason)
{
	char addr[BT_ADDR_LE_STR_LEN];

	if (conn != default_conn) {
		return;
	}

	bt_addr_le_to_str(bt_conn_get_dst(conn), addr, sizeof(addr));

	printk("Disconnected: %s (reason 0x%02x)\n", addr, reason);

	bt_conn_unref(default_conn);
	default_conn = NULL;

	start_scan();
}

static struct bt_conn_cb central_cb;

#if 0
BT_CONN_CB_DEFINE(conn_callbacks) = {
	.connected = connected,
	.disconnected = disconnected,
};
#endif

void test_central_main()
{
	printk("Sender\n");

	int err;

	central_cb.connected = connected;
        central_cb.disconnected = disconnected;

        bt_conn_cb_register(&central_cb);

	err = bt_enable(NULL);
	if (err) {
                printk("Bluetooth init failed (err %d)\n", err);
                return;
        }

	start_scan();

        // smp_send_bad();

	// printk("test\n");

        // PASS("Central test passed\n");
}
```

## src/peripheral.c
```c
#include <stddef.h>
#include <stdint.h>
#include <string.h>

#include <zephyr/kernel.h>

#include <zephyr/sys/printk.h>

#include <zephyr/bluetooth/conn.h>
#include <zephyr/bluetooth/bluetooth.h>

static struct bt_conn *default_conn;

static const struct bt_data adv_ad_data[] = {
	BT_DATA_BYTES(BT_DATA_FLAGS, (BT_LE_AD_GENERAL | BT_LE_AD_NO_BREDR))};


static void connected(struct bt_conn *conn, uint8_t err)
{
	printk("Peripheral Connected function\n");

	char addr[BT_ADDR_LE_STR_LEN];

	bt_addr_le_to_str(bt_conn_get_dst(conn), addr, sizeof(addr));

	printk("Connected: %s\n", addr);

        default_conn = bt_conn_ref(conn);
}

static void disconnected(struct bt_conn *conn, uint8_t reason)
{
	char addr[BT_ADDR_LE_STR_LEN];

	if (conn != default_conn) {
		return;
	}

	bt_addr_le_to_str(bt_conn_get_dst(conn), addr, sizeof(addr));

	printk("Disconnected: %s (reason 0x%02x)\n", addr, reason);

	bt_conn_unref(default_conn);
	default_conn = NULL;
}

static struct bt_conn_cb peri_cb;
#if 0
BT_CONN_CB_DEFINE(conn_callbacks) = {
	.connected = connected,
	.disconnected = disconnected,
};
#endif


void test_peripheral_main()
{
	printk("Receiver\n");

        int err;

        peri_cb.connected = connected;
        peri_cb.disconnected = disconnected;

        bt_conn_cb_register(&peri_cb);

        err = bt_enable(NULL);
        if (err) {
                printk("Bluetooth init failed (err %d)\n", err);
                return;
        }

        printk("Bluetooth initialized\n");

	bt_le_adv_start(BT_LE_ADV_CONN_NAME, adv_ad_data, ARRAY_SIZE(adv_ad_data), NULL, 0);

        while (true) {
	        k_sleep(K_SECONDS(1));
        }

        // PASS("Peripheral test passed\n");
}
```
