## samples/bluetooth/hci_uart/boards/nrf52833dk_nrf52833.conf
```kconfig
CONFIG_USB_DEVICE_STACK=y
CONFIG_USB_DEVICE_PRODUCT="Zephyr HCI UART sample"
CONFIG_USB_CDC_ACM=y
CONFIG_USB_DEVICE_INITIALIZE_AT_BOOT=n

CONFIG_BT_SUBRATING=y
CONFIG_BT_ISO_PERIPHERAL=y
CONFIG_BT_ISO_CENTRAL=y
CONFIG_BT_ISO_BROADCASTER=y
CONFIG_BT_ISO_SYNC_RECEIVER=y
CONFIG_BT_EXT_ADV=y
CONFIG_BT_EXT_ADV_MAX_ADV_SET=4
CONFIG_BT_PER_ADV_SYNC_TRANSFER_RECEIVER=y
CONFIG_BT_PER_ADV_SYNC_TRANSFER_SENDER=y
CONFIG_BT_LL_SW_SPLIT=n
CONFIG_USB_DEVICE_REMOTE_WAKEUP=n

CONFIG_BT_CTLR_LE_POWER_CONTROL=y
CONFIG_BT_CTLR_TX_PWR_PLUS_8=y

CONFIG_BT_CTLR_ADV_ISO=y
CONFIG_BT_CTLR_SCA_UPDATE=y
CONFIG_BT_CTLR_PHY_CODED=n
# CONFIG_BT_CTLR_ADV_DATA_LEN_MAX=1650
CONFIG_BT_CTLR_ADV_DATA_LEN_MAX=191
CONFIG_BT_BUF_ACL_RX_SIZE=258
CONFIG_BT_BUF_ACL_TX_SIZE=251
CONFIG_BT_CTLR_DATA_LENGTH_MAX=251
CONFIG_BT_CTLR_CONN_ISO_GROUPS=2
CONFIG_BT_CTLR_CONN_ISO_STREAMS=4
CONFIG_BT_CTLR_SYNC_ISO_STREAM_COUNT=4
CONFIG_BT_CTLR_ADV_ISO_SET=4
CONFIG_BT_CTLR_ADV_ISO_STREAM_COUNT=4
CONFIG_BT_ISO_TX_BUF_COUNT=10

# Support two links as a central, or one link as a peripheral
CONFIG_BT_MAX_CONN=5

CONFIG_BT_COMPANY_ID=0x07E8
CONFIG_BT_CTLR_COMPANY_ID=0x07E8

CONFIG_USB_DEVICE_PID=0x521f
CONFIG_USB_DEVICE_VID=0x1915
CONFIG_USB_DEVICE_PRODUCT="nRF52 USB Product"
CONFIG_USB_DEVICE_SN="F96CEB139931"
CONFIG_USB_DEVICE_MANUFACTURER="Nordic Semiconductor"
```
