## subsys/bluetooth/crypto/Kconfig
```kconfig
# Copyright (c) 2022 Nordic Semiconductor ASA
# SPDX-License-Identifier: Apache-2.0

config BT_CRYPTO
	bool
	select TINYCRYPT
	select TINYCRYPT_AES
	select TINYCRYPT_AES_CMAC
	help
	  This option enables the Bluetooth Cryptographic Toolbox.

parent-module = BT
module = BT_CRYPTO
module-str = "Bluetooth Cryptographic Toolbox"
source "${ZEPHYR_BASE}/subsys/logging/Kconfig.template.log_config_inherit"
```

## subsys/bluetooth/crypto_toolbox/Kconfig
```kconfig
config BT_CRYPTO_H8
    bool ""
    default y
    select CONFIG_BT_TINYCRYPT
    help
        desc
endif # BT_CONN
```

## tests/bluetooth/tester/Kconfig.sysbuild
```kconfig
source "share/sysbuild/Kconfig"

config HCI_IPC_NETCORE
        bool "Build hci_ipc for the network core"
        default y if SOC_NRF5340_CPUAPP

config HCI_IPC_CORE_BOARD
	string "Board name for the hci_ipc application"
	default "nrf5340dk/nrf5340/cpunet" if SOC_NRF5340_CPUAPP
    depends on HCI_IPC_NETCORE
```

## tests/bluetooth/tester/boards/nrf5340dk_nrf5340_cpuapp.conf
```kconfig
# CONFIG_TEST enforces minimal logging, which we don't want
CONFIG_TEST=n

CONFIG_ASSERT=y
# Enable the option below to measure stack usage
#CONFIG_INIT_STACKS=y
CONFIG_THREAD_NAME=y
CONFIG_HW_STACK_PROTECTION=y

CONFIG_LOG=y
CONFIG_LOG_BUFFER_SIZE=4096
CONFIG_RTT_CONSOLE=y
CONFIG_LOG_BACKEND_RTT=y
CONFIG_LOG_BACKEND_RTT_MODE_DROP=y
CONFIG_USE_SEGGER_RTT=y
CONFIG_SEGGER_RTT_BUFFER_SIZE_UP=4096
CONFIG_LOG_BACKEND_SHOW_COLOR=n
CONFIG_LOG_PROCESS_THREAD_STACK_SIZE=1024

CONFIG_LOG_DEFAULT_LEVEL=3
CONFIG_BTTESTER_LOG_LEVEL_DBG=y

CONFIG_UART_INTERRUPT_DRIVEN=y



CONFIG_BT_BUF_EVT_RX_COUNT=16
CONFIG_BT_BUF_EVT_RX_SIZE=255

# Tightly coupled with BT_CTLR_DATA_LENGTH_MAX
CONFIG_BT_BUF_ACL_RX_SIZE=100
CONFIG_BT_CTLR_DATA_LENGTH_MAX=100

CONFIG_BT_PRIVACY=n
CONFIG_BT_EXT_ADV=y
CONFIG_BT_PER_ADV=y
CONFIG_BT_PER_ADV_SYNC=y
```
